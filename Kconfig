## setup/Kconfig
```kconfig
#
# IR0 Kernel Configuration
#
# This file defines every user-visible configuration symbol.
# Only subsystems that can actually be compiled out are toggleable;
# core subsystems (memory, scheduler, VFS, interrupts) are always built.
#

menu "Architecture"

    config ARCH_X86_64
        bool "Target architecture: x86-64"
        default y
        help
          Build the kernel for x86-64 targets using the current GRUB/Multiboot flow.

    config ARCH_ARM64
        bool "Target architecture: ARM64 (AArch64)"
        default n
        help
          Build the kernel for ARM64 targets.
          This port is scaffolded and intended for incremental bring-up.

endmenu

menu "General"

    config KERNEL_DEBUG_SHELL
        bool "Use debug shell as init (PID 1)"
        default y
        help
          When enabled the kernel boots into the built-in debug shell
          instead of loading /sbin/init from the filesystem.
          Disable this only when you have a working userspace init.

    config TICK_RATE_HZ
        int "Timer tick rate (Hz)"
        range 100 1000
        default 1000
        help
          Frequency of the PIT timer interrupt. Higher values give finer
          scheduling granularity at the cost of more IRQ overhead.

    config SCHEDULER_POLICY
        int "Scheduler policy (0=round-robin,1=cfs,2=priority)"
        range 0 2
        default 0
        help
          Build-time scheduler selection.
          0 = round-robin (stable reference)
          1 = cfs (currently aliases RR backend)
          2 = priority (currently aliases RR backend)

    config ROOT_BLOCK_DEVICE
        string "Default root block device name"
        default "hda"
        help
          Logical block device used for root mount attempt.

    config ROOT_FILESYSTEM
        string "Default root filesystem type"
        default "minix"
        help
          Filesystem type used for root mount attempt.

    config ENABLE_SMP
        bool "Enable SMP build hooks (experimental)"
        default n
        help
          Enables SMP-oriented compile-time hooks. Runtime SMP support is
          still work-in-progress.

    config ENABLE_EXAMPLE_DRIVERS
        bool "Enable example external drivers (C++/Rust)"
        default n
        help
          Build and register optional sample drivers used for multi-language
          integration testing. Keep disabled for production-like builds.

endmenu

menu "Debug Binaries"

    config DEBUG_BINS_GROUP_CORE
        bool "Debug bins core commands"
        default y
        help
          Build core shell-facing commands such as ls/cd/pwd/cat/echo/exec
          plus tiny process helpers like true/false/sleep.

    config DEBUG_BINS_GROUP_FS
        bool "Debug bins filesystem commands"
        default y
        help
          Build filesystem management commands: mkdir/rm/rmdir/touch/cp/mv/ln
          and permission/mount tools such as chmod/chown/mount.

    config DEBUG_BINS_GROUP_TEXT
        bool "Debug bins text processing commands"
        default y
        help
          Build small text tools such as sed/wc/head/tail.

    config DEBUG_BINS_GROUP_IDENTITY
        bool "Debug bins identity/privilege commands"
        default y
        help
          Build identity-oriented commands like id/whoami and privilege helper
          commands such as sudo.

    config DEBUG_BINS_GROUP_DIAG
        bool "Debug bins diagnostics/system-info commands"
        default y
        help
          Build diagnostics and system-info commands (ps/df/dmesg/free/uptime/
          date/uname/lsblk/lsdrv/lshw/keymap/stat).

    config DEBUG_BINS_GROUP_NET
        bool "Debug bins networking commands"
        default y
        depends on ENABLE_NETWORKING
        help
          Build networking debug bins such as ping.

    config DEBUG_BINS_GROUP_BT
        bool "Debug bins Bluetooth commands"
        default y
        depends on ENABLE_BLUETOOTH
        help
          Build Bluetooth-oriented debug bins (lsblue/bluestart/blue).

endmenu

menu "Networking"

    config ENABLE_NETWORKING
        bool "IPv4 network stack (ARP, IP, ICMP, UDP, DNS)"
        default y
        help
          Compile the full network stack (net/).
          Disabling this removes all networking support from the kernel.

    config DRV_NIC_RTL8139
        bool "Driver plugin: RTL8139 NIC"
        default y
        depends on ENABLE_NETWORKING && ARCH_X86_64
        help
          Compile and probe the RTL8139 network interface driver plugin.

    config DRV_NIC_E1000
        bool "Driver plugin: Intel E1000 NIC (scaffold)"
        default n
        depends on ENABLE_NETWORKING && ARCH_X86_64
        help
          Reserved plugin switch for future Intel E1000 support.

endmenu

menu "Sound"

    config ENABLE_SOUND
        bool "Sound subsystem (Sound Blaster 16 + Adlib OPL2)"
        default y
        help
          Compile the Sound Blaster 16 and Adlib OPL2 audio drivers
          plus the ISA DMA helper used by SB16.

endmenu

menu "Bluetooth"

    config ENABLE_BLUETOOTH
        bool "Bluetooth HCI over UART"
        default y
        help
          Compile the Bluetooth HCI-UART transport, device manager,
          and sysfs/procfs integration.

endmenu

menu "Input"

    config ENABLE_MOUSE
        bool "PS/2 mouse driver"
        default y
        help
          Compile the PS/2 mouse driver. The PS/2 keyboard is always built.

    config KEYBOARD_LAYOUT
        int "Keyboard layout (0=us,1=latam)"
        range 0 1
        default 0
        help
          Default keyboard layout used by the PS/2 keyboard driver.
          0 = us
          1 = latam

endmenu

menu "Storage"

    config ENABLE_STORAGE_ATA
        bool "ATA/IDE storage driver"
        default y
        help
          Compile ATA core read/write support.

    config ENABLE_STORAGE_ATA_BLOCK
        bool "ATA block-device registration layer"
        default y
        depends on ENABLE_STORAGE_ATA
        help
          Register ATA devices as block devices (hda/hdb/...) for VFS/devfs.

endmenu

menu "Filesystems"

    config ENABLE_FS_MINIX
        bool "MINIX filesystem driver"
        default y
        help
          Compile MINIX filesystem support (disk-backed root and regular mounts).

    config ENABLE_FS_TMPFS
        bool "TMPFS filesystem driver"
        default y
        help
          Compile TMPFS in-memory filesystem support.
          Recommended enabled as fallback root when disk mount fails.

    config ENABLE_FS_SIMPLEFS
        bool "SimpleFS filesystem driver"
        default y
        help
          Compile a minimal low-complexity filesystem backend intended for
          mount coexistence and scaling validation.

    config ENABLE_FS_FAT16
        bool "FAT16-like filesystem driver"
        default y
        help
          Compile a minimal FAT16-like backend for mount coexistence tests
          using coherent mountpoint semantics.

endmenu

menu "Platform Devices"

    config ENABLE_PC_SPEAKER
        bool "PC speaker driver"
        default y
        help
          Compile the PC speaker driver (port 0x61 + PIT channel 2).

endmenu

menu "Graphics"

    config ENABLE_VBE
        bool "VBE framebuffer support"
        default y
        help
          Use the VESA BIOS Extensions framebuffer when available
          (via Multiboot). VGA text-mode console is always compiled.

endmenu

menu "Driver Init Selection"

    comment "Only selectable hardware stacks live here."
    comment "Core boot drivers (serial, timer, interrupt plumbing) are always-on."

    config INIT_PS2_CONTROLLER
        bool "Initialize PS/2 controller"
        default y

    config INIT_PC_SPEAKER
        bool "Initialize PC speaker"
        default y
        depends on ENABLE_PC_SPEAKER

    config INIT_STORAGE_ATA
        bool "Initialize ATA core driver"
        default y
        depends on ENABLE_STORAGE_ATA

    config INIT_STORAGE_ATA_BLOCK
        bool "Register ATA block device layer"
        default y
        depends on ENABLE_STORAGE_ATA_BLOCK
        depends on INIT_STORAGE_ATA

    config INIT_SOUND_DRIVERS
        bool "Initialize sound drivers at boot"
        default y
        depends on ENABLE_SOUND

    config INIT_MOUSE_DRIVER
        bool "Initialize PS/2 mouse driver at boot"
        default y
        depends on ENABLE_MOUSE
        depends on INIT_PS2_CONTROLLER

    config INIT_NETWORK_STACK
        bool "Initialize network stack at boot"
        default y
        depends on ENABLE_NETWORKING

    config INIT_BLUETOOTH_DRIVER
        bool "Register Bluetooth driver at boot"
        default y
        depends on ENABLE_BLUETOOTH

endmenu

menu "Tooling"

    config TOOL_AUTO_RUN_DEPTEST
        bool "Run deptest automatically before 'make ir0'"
        default n
        help
          When enabled, 'make ir0' executes dependency checks first.
          Useful for new contributors or CI-like local flows.

    config TOOL_DEFAULT_DISK_FS
        int "Default filesystem for create-disk (0=minix,1=fat32,2=ext4)"
        range 0 2
        default 0
        help
          Select which filesystem create-disk uses when no arguments
          are passed to the make target.

    config TOOL_DEFAULT_DISK_SIZE_MB
        int "Default disk size for create-disk (MB)"
        range 64 8192
        default 200
        help
          Disk size used by create-disk when no explicit size is passed.

    config TOOL_UNIBUILD_DEFAULT_FILES
        string "Default files for unibuild targets (space-separated)"
        help
          Optional default files used by unibuild targets when no positional
          file arguments are provided. Example: fs/vfs.c fs/path.c

    config TOOL_UNIBUILD_EXCLUDE_FILE
        string "Exclude one file from unibuild target file list"
        help
          If set, this exact file path is removed from unibuild target input
          before invoking scripts/unibuild.sh.

    config TOOL_MENUCONFIG_LANG
        string "menuconfig UI language (en/es)"
        default "en"
        help
          Language for menuconfig UI labels and prompts.
          Supported values are:
          - en (English)
          - es (Spanish)

endmenu

menu "Debugging"

    config DEBUG_MEMORY_ALLOCATOR
        bool "Heap allocator debug output"
        default n

    config DEBUG_PMM
        bool "Physical memory manager debug output"
        default n

    config DEBUG_MEMORY_COALESCING
        bool "Allocator coalescing debug output"
        default n

    config DEBUG_MEMORY_STATS
        bool "Allocator statistics debug output"
        default n

    config DEBUG_PAGING
        bool "Paging operations debug output"
        default n

    config DEBUG_PAGE_FAULTS
        bool "Page fault handler debug output"
        default n

    config DEBUG_PROCESS
        bool "Process creation/destruction debug"
        default n

    config DEBUG_SCHEDULER
        bool "Scheduler debug output"
        default n

    config DEBUG_FORK
        bool "Fork path debug output"
        default n

    config DEBUG_VFS
        bool "VFS operations debug output"
        default n

    config DEBUG_FS_MOUNT
        bool "Filesystem mount/unmount debug output"
        default n

    config DEBUG_SYSCALLS
        bool "Syscall invocations debug output"
        default n

    config DEBUG_SYSCALL_PARAMS
        bool "Detailed syscall parameter debug output"
        default n

    config DEBUG_KEYBOARD
        bool "Keyboard/stdin read debug output"
        default n

endmenu
```

## setup/defconfig
```kconfig
#
# IR0 Kernel Default Configuration
# All features enabled — copy to .config or run: make defconfig
#

CONFIG_ARCH_X86_64=y
CONFIG_ARCH_ARM64=n
CONFIG_KERNEL_DEBUG_SHELL=y
CONFIG_IR0_SUDO_AUTH_SYSCALL=n
CONFIG_TICK_RATE_HZ=1000
CONFIG_SCHEDULER_POLICY=0
CONFIG_ROOT_BLOCK_DEVICE=hda
CONFIG_ROOT_FILESYSTEM=minix
CONFIG_ENABLE_SMP=n
CONFIG_ENABLE_EXAMPLE_DRIVERS=n
CONFIG_DEBUG_BINS_GROUP_CORE=y
CONFIG_DEBUG_BINS_GROUP_FS=y
CONFIG_DEBUG_BINS_GROUP_TEXT=y
CONFIG_DEBUG_BINS_GROUP_IDENTITY=y
CONFIG_DEBUG_BINS_GROUP_DIAG=y
CONFIG_DEBUG_BINS_GROUP_NET=y
CONFIG_DEBUG_BINS_GROUP_BT=y
CONFIG_ENABLE_NETWORKING=y
CONFIG_DRV_NIC_RTL8139=y
CONFIG_DRV_NIC_E1000=n
CONFIG_ENABLE_SOUND=y
CONFIG_ENABLE_BLUETOOTH=y
CONFIG_ENABLE_USB_HOST=n
CONFIG_ENABLE_MOUSE=y
CONFIG_KEYBOARD_LAYOUT=0
CONFIG_ENABLE_STORAGE_ATA=y
CONFIG_ENABLE_STORAGE_ATA_BLOCK=y
CONFIG_ENABLE_FS_MINIX=y
CONFIG_ENABLE_FS_TMPFS=y
CONFIG_ENABLE_FS_SIMPLEFS=y
CONFIG_ENABLE_FS_FAT16=y
CONFIG_ENABLE_PC_SPEAKER=y
CONFIG_ENABLE_VBE=y
CONFIG_INIT_PS2_CONTROLLER=y
CONFIG_INIT_PC_SPEAKER=y
CONFIG_INIT_STORAGE_ATA=y
CONFIG_INIT_STORAGE_ATA_BLOCK=y
CONFIG_INIT_SOUND_DRIVERS=y
CONFIG_INIT_MOUSE_DRIVER=y
CONFIG_INIT_NETWORK_STACK=y
CONFIG_INIT_BLUETOOTH_DRIVER=y
CONFIG_INIT_USB_HOST=n
CONFIG_TOOL_AUTO_RUN_DEPTEST=n
CONFIG_TOOL_DEFAULT_DISK_FS=0
CONFIG_TOOL_DEFAULT_DISK_SIZE_MB=200
CONFIG_TOOL_UNIBUILD_DEFAULT_FILES=
CONFIG_TOOL_UNIBUILD_EXCLUDE_FILE=
CONFIG_TOOL_MENUCONFIG_LANG=en
CONFIG_DEBUG_MEMORY_ALLOCATOR=n
CONFIG_DEBUG_PMM=n
CONFIG_DEBUG_MEMORY_COALESCING=n
CONFIG_DEBUG_MEMORY_STATS=n
CONFIG_DEBUG_PAGING=n
CONFIG_DEBUG_PAGE_FAULTS=n
CONFIG_DEBUG_D1_DIAG=n
CONFIG_DEBUG_MMAP_AUDIT=n
CONFIG_LAZY_ANON_MMAP=y
CONFIG_LAZY_BRK_HEAP=y
CONFIG_DEBUG_PROCESS=n
CONFIG_DEBUG_SCHEDULER=n
CONFIG_DEBUG_FORK=n
CONFIG_DEBUG_VFS=n
CONFIG_DEBUG_FS_MOUNT=n
CONFIG_DEBUG_SYSCALLS=n
CONFIG_DEBUG_SYSCALL_PARAMS=n
CONFIG_DEBUG_KEYBOARD=n
CONFIG_TEST_INPUT_INJECT=y
CONFIG_DEBUG_ISRABI=n
CONFIG_DEBUG_FASE50=n
CONFIG_DEBUG_FASE51=n
CONFIG_DEBUG_FASE52=n
CONFIG_KTM=y
CONFIG_KTM_EVENTS=y
CONFIG_KTM_FLIGHT=y
CONFIG_KTM_PROBE_DIAG=n
CONFIG_KTM_MALLOC_FORENSICS=n
```
